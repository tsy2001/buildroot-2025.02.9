## br2-external-u8g2-splitlibs/Config.in
```kconfig
menu "U8g2 split libraries"
    source "$BR2_EXTERNAL_U8G2SPLIT_PATH/package/u8g2-core/Config.in"
    source "$BR2_EXTERNAL_U8G2SPLIT_PATH/package/u8g2-fonts/Config.in"
endmenu
```

## br2-external-u8g2-splitlibs/package/u8g2-core/Config.in
```kconfig
config BR2_PACKAGE_U8G2_CORE
    bool "u8g2-core (libu8g2.so, without built-in fonts)"
    help
      Build U8g2 as a shared library, excluding the huge built-in font data.
      You must provide upstream u8g2 sources under:
        $(BR2_EXTERNAL_U8G2SPLIT_PATH)/package/u8g2-core/u8g2
      The directory must contain csrc/ (u8g2 C sources).
```

## br2-external-u8g2-splitlibs/package/u8g2-fonts/Config.in
```kconfig
config BR2_PACKAGE_U8G2_FONTS
    bool "u8g2-fonts (libu8g2font.so, only selected fonts)"
    depends on BR2_PACKAGE_U8G2_CORE
    help
      Build selected u8g2 font C files into a separate shared library.
      Put the font .c files you need under:
        $(BR2_EXTERNAL_U8G2SPLIT_PATH)/package/u8g2-fonts/fonts
      Example generated by bdfconv:
        u8g2_font_misans_16_cjk.c
```
